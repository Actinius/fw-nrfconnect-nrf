## CMakeLists.txt
```
#
# Copyright (c) 2019 Actinius
#
# SPDX-License-Identifier: BSD-3-Clause
#

cmake_minimum_required(VERSION 3.8.2)

include($ENV{ZEPHYR_BASE}/cmake/app/boilerplate.cmake NO_POLICY_SCOPE)
project(sms_sample)

zephyr_include_directories(src)
target_sources(app PRIVATE src/main.c)
target_sources(app PRIVATE src/pdu.c)
```

## Kconfig
```
# Kconfig - Actinius Icarus board configuration
#
# Copyright (c) 2019 Actinius
#
# SPDX-License-Identifier: Apache-2.0

menu "SMS sample"
config SMSC_NUMBER
	string "SMSC number"
	default "46707000440"

endmenu

menu "Zephyr Kernel"
source "$ZEPHYR_BASE/Kconfig.zephyr"
endmenu
```

## sample.yaml
```
sample:
  name: SMS sample
tests:
  test_build:
    build_only: true
    build_on_all: true
    platform_whitelist: actinius_icarus_ns
    tags: ci_build
```

## prj.conf
```kconfig
CONFIG_TEST_RANDOM_GENERATOR=y

CONFIG_NEWLIB_LIBC=y
CONFIG_BSD_LIBRARY=y

CONFIG_NETWORKING=y
CONFIG_NET_SOCKETS_OFFLOAD=y
CONFIG_NET_SOCKETS=y
CONFIG_NET_SOCKETS_POSIX_NAMES=y

CONFIG_LTE_LINK_CONTROL=y
CONFIG_LTE_AUTO_INIT_AND_CONNECT=n

CONFIG_MAIN_STACK_SIZE=4096
CONFIG_HEAP_MEM_POOL_SIZE=1024

CONFIG_GPIO=y

CONFIG_BOARD_SELECT_SIM_EXTERNAL=n
CONFIG_SMSC_NUMBER="46707000440"
```

## src/main.c
```c
/*
 * Copyright (c) 2019 Actinius
 *
 * SPDX-License-Identifier: BSD-3-Clause
 */

#include <gpio.h>
#include <at_cmd.h>
#include <stdio.h>
#include <string.h>
#include <lte_lc.h>
#include "pdu.h"

#define BUTTON SW0_GPIO_PIN

// #define SMS_DESTINATION_NUMBER "31648999999"

#if !defined(SMS_DESTINATION_NUMBER)
#error "Please uncomment and fill in the mentioned variable"
#endif

static struct device *gpio_dev;
static struct gpio_callback gpio_cb;
static char modem_buffer[384]; // this is used to receive the encoded SMS from the modem and to send the AT command to the modem
static uint8_t modem_buffer_pdu_bytes[192];
static char decoded_sms_message[192];
static uint8_t encoded_pdu[192];
static bool button_pressed = false;

void button_pressed_callback(struct device *gpiob, struct gpio_callback *cb, u32_t pins)
{
	button_pressed = true;
}

void init_button(void)
{
	gpio_dev = device_get_binding(DT_GPIO_P0_DEV_NAME);

	if (!gpio_dev) {
		printk("Error getting " DT_GPIO_P0_DEV_NAME " device binding\r\n");

		return;
	}

	gpio_pin_configure(gpio_dev, BUTTON, GPIO_DIR_IN | GPIO_PUD_PULL_UP | GPIO_INT | GPIO_INT_DEBOUNCE | GPIO_INT_EDGE);
	gpio_init_callback(&gpio_cb, button_pressed_callback, BIT(BUTTON));

	gpio_add_callback(gpio_dev, &gpio_cb);
	gpio_pin_enable_callback(gpio_dev, BUTTON);
}

static uint8_t convert_hex_char_to_byte_value(char c)
{
	if (c >= 'A' && c <= 'F') {
		return ((uint8_t)c - 55);
	} else {
		return ((uint8_t)c - 48);
	}

	return 0;
}

static uint8_t convert_hex_string_to_byte_array(char *buffer, uint8_t *byte_array)
{
	uint8_t index = 0;

	for (int i = 0; i < strlen(buffer); i += 2) {
		byte_array[index] = 16 * convert_hex_char_to_byte_value(buffer[i]) + convert_hex_char_to_byte_value(buffer[i + 1]);
		index++;
	}

	return index;
}

static void sms_received_handler(char *response)
{
	memset(modem_buffer, 0, sizeof(modem_buffer));

	if (sscanf(response, "+CMT: \"%*[^\"]\",%*d\r%s", modem_buffer) != 1) {
		printk("Could not parse modem response\n");

		return;
	}

	memset(modem_buffer_pdu_bytes, 0, sizeof(modem_buffer_pdu_bytes));
	uint8_t modem_buffer_pdu_bytes_nr = convert_hex_string_to_byte_array(modem_buffer, modem_buffer_pdu_bytes);

	time_t decoded_sms_time;
	char decoded_sms_number[20] = { '\0', };
	memset(decoded_sms_message, 0, sizeof(decoded_sms_message));

	if (pdu_decode(modem_buffer_pdu_bytes, modem_buffer_pdu_bytes_nr, &decoded_sms_time, decoded_sms_number,
		       sizeof(decoded_sms_number), decoded_sms_message, sizeof(decoded_sms_message)) < 0) {
		printk("Could not decode sms message\n");

		return;
	}

	printk("SMS message \"%s\" received from \"%s\"\n", decoded_sms_message, decoded_sms_number);
}

static void at_callback(char *response)
{
	if (strlen(response) == 0) {
		return;
	}

	printk("Modem response: %s\n", response);
}

bool sms_client_init(void)
{
	enum at_cmd_state state;

	at_cmd_write_with_callback("AT+CNMI=3,2,0,1", at_callback, &state);

	return true;
}

void sms_client_send(const char *sms_text, const char *destination_number)
{
	memset(encoded_pdu, 0, sizeof(encoded_pdu));
	int encode_size = pdu_encode(CONFIG_SMSC_NUMBER, destination_number, sms_text, encoded_pdu, sizeof(encoded_pdu));

	uint8_t smsc_length = encoded_pdu[0] + 1;
	uint8_t tpdu_length = encode_size - smsc_length;

	memset(modem_buffer, 0, sizeof(modem_buffer));
	snprintk(modem_buffer, sizeof(modem_buffer), "AT+CMGS=%d\r", tpdu_length);

	for (int i = 0; i < encode_size; i++) {
		char byte[3] = { '\0', };
		snprintk(byte, sizeof(byte), "%02x", encoded_pdu[i]);
		strcat(modem_buffer, byte);
	}

	strcat(modem_buffer, "\x1a");

	enum at_cmd_state state;
	at_cmd_write_with_callback(modem_buffer, at_callback, &state);
}

void sms_client_register_receive(void)
{
	at_cmd_set_notification_handler(sms_received_handler);
}

void sms_client_unregister_receive(void)
{
	at_cmd_set_notification_handler(NULL);
}

void connect_to_network(void)
{
#if defined(CONFIG_LTE_LINK_CONTROL)
	if (IS_ENABLED(CONFIG_LTE_AUTO_INIT_AND_CONNECT)) {
		/* Do nothing, modem is already turned on
		 * and connected.
		 */
	} else {
		int err;

		printk("LTE Link Connecting ...\n");
		err = lte_lc_init_and_connect();
		__ASSERT(err == 0, "LTE link could not be established.");
		printk("LTE Link Connected!\n");
	}
#endif
}

int main(void)
{
	printk("Starting SMS sample\n");

	init_button();
	connect_to_network();
	sms_client_init();
	sms_client_register_receive();

	while (1) {
		if (button_pressed) {
			printk("Sending SMS message\n");
			sms_client_send("Button was pressed", SMS_DESTINATION_NUMBER);

			button_pressed = false;
		}

		k_sleep(200);
	}

	return 0;
}
```

## src/pdu.c
```c
// Copyright 2011 The Avalon Project Authors. All rights reserved.
// Use of this source code is governed by the Apache License 2.0
// that can be found in the LICENSE file.
//
//  SMS encoding/decoding functions, which are based on examples from:
//  http://www.dreamfabric.com/sms/

#include "pdu.h"

#include <string.h>
#include <time.h>

enum {
	BITMASK_7BITS                           = 0x7F,
	BITMASK_8BITS                           = 0xFF,
	BITMASK_HIGH_4BITS                      = 0xF0,
	BITMASK_LOW_4BITS                       = 0x0F,

	TYPE_OF_ADDRESS_INTERNATIONAL_PHONE     = 0x91,
	TYPE_OF_ADDRESS_NATIONAL_SUBSCRIBER     = 0xC8,

	SMS_DELIVER_ONE_MESSAGE                 = 0x04,
	SMS_SUBMIT                              = 0x11,

	SMS_MAX_7BIT_TEXT_LENGTH                = 160,
};

// Swap decimal digits of a number (e.g. 12 -> 21).
static unsigned char SwapDecimalNibble(const unsigned char x)
{
	return (x / 16) + ((x % 16) * 10);
}

// Encode/Decode PDU: Translate ASCII 7bit characters to 8bit buffer.
// SMS encoding example from: http://www.dreamfabric.com/sms/.
//
// 7-bit ASCII: "hellohello"
// [0]:h   [1]:e   [2]:l   [3]:l   [4]:o   [5]:h   [6]:e   [7]:l   [8]:l   [9]:o
// 1101000 1100101 1101100 1101100 1101111 1101000 1100101 1101100 1101100 1101111
//               |             |||           ||||| |               |||||||  ||||||
// /-------------/   ///-------///     /////-///// \------------\  |||||||  \\\\\\ .
// |                 |||               |||||                    |  |||||||   ||||||
// input buffer position
// 10000000 22111111 33322222 44443333 55555333 66666655 77777776 98888888 --999999
// |                 |||               |||||                    |  |||||||   ||||||
// 8bit encoded buffer
// 11101000 00110010 10011011 11111101 01000110 10010111 11011001 11101100 00110111
// E8       32       9B       FD       46       97       D9       EC       37


// Encode PDU message by merging 7 bit ASCII characters into 8 bit octets.
static int EncodePDUMessage(const char *sms_text, int sms_text_length, unsigned char *output_buffer, int buffer_size)
{
	// Check if output buffer is big enough.
	if ((sms_text_length * 7 + 7) / 8 > buffer_size) {
		return -1;
	}

	int output_buffer_length = 0;
	int carry_on_bits = 1;
	int i = 0;

	for (; i < sms_text_length - 1; ++i) {
		output_buffer[output_buffer_length++] =
			((sms_text[i] & BITMASK_7BITS) >> (carry_on_bits - 1)) |
			((sms_text[i + 1] & BITMASK_7BITS) << (8 - carry_on_bits));
		carry_on_bits++;
		if (carry_on_bits == 8) {
			carry_on_bits = 1;
			++i;
		}
	}


	if (i < sms_text_length) {
		output_buffer[output_buffer_length++] = (sms_text[i] & BITMASK_7BITS) >> (carry_on_bits - 1);
	}

	return output_buffer_length;
}

// Decode PDU message by splitting 8 bit encoded buffer into 7 bit ASCII
// characters.
static int DecodePDUMessage(const unsigned char *buffer, int buffer_length, char *output_sms_text, int sms_text_length)
{
	int output_text_length = 0;

	if (buffer_length > 0) {
		output_sms_text[output_text_length++] = BITMASK_7BITS & buffer[0];
	}

	int carry_on_bits = 1;
	int i = 1;
	for (; i < buffer_length; ++i) {

		output_sms_text[output_text_length++] = BITMASK_7BITS & ((buffer[i] << carry_on_bits) | (buffer[i - 1] >> (8 - carry_on_bits)));

		if (output_text_length == sms_text_length) {
			break;
		}

		carry_on_bits++;

		if (carry_on_bits == 8) {
			carry_on_bits = 1;
			output_sms_text[output_text_length++] = buffer[i] & BITMASK_7BITS;
			if (output_text_length == sms_text_length) {
				break;
			}
		}

	}
	if (output_text_length < sms_text_length) { // Add last remainder.
		output_sms_text[output_text_length++] = buffer[i - 1] >> (8 - carry_on_bits);
	}

	return output_text_length;
}

// Encode a digit based phone number for SMS based format.
static int EncodePhoneNumber(const char *phone_number, unsigned char *output_buffer, int buffer_size)
{
	int output_buffer_length = 0;
	const int phone_number_length = strlen(phone_number);

	// Check if the output buffer is big enough.
	if ((phone_number_length + 1) / 2 > buffer_size) {
		return -1;
	}

	int i = 0;
	for (; i < phone_number_length; ++i) {

		if (phone_number[i] < '0' && phone_number[i] > '9') {
			return -1;
		}

		if (i % 2 == 0) {
			output_buffer[output_buffer_length++] = BITMASK_HIGH_4BITS | (phone_number[i] - '0');
		} else {
			output_buffer[output_buffer_length - 1] =
				(output_buffer[output_buffer_length - 1] & BITMASK_LOW_4BITS) |
				((phone_number[i] - '0') << 4);
		}
	}

	return output_buffer_length;
}

// Decode a digit based phone number for SMS based format.
static int DecodePhoneNumber(const unsigned char *buffer, int phone_number_length, char *output_phone_number)
{
	int i = 0;

	for (; i < phone_number_length; ++i) {
		if (i % 2 == 0) {
			output_phone_number[i] = (buffer[i / 2] & BITMASK_LOW_4BITS) + '0';
		} else {
			output_phone_number[i] = ((buffer[i / 2] & BITMASK_HIGH_4BITS) >> 4) + '0';
		}
	}
	output_phone_number[phone_number_length] = '\0';  // Terminate C string.
	return phone_number_length;
}

// Encode a SMS message to PDU
int pdu_encode(const char *service_center_number, const char *phone_number, const char *sms_text,
	   unsigned char *output_buffer, int buffer_size)
{
	if (buffer_size < 2) {
		return -1;
	}

	int output_buffer_length = 0;

	// 1. Set SMS center number.
	int length = 0;
	if (service_center_number && strlen(service_center_number) > 0) {
		output_buffer[1] = TYPE_OF_ADDRESS_INTERNATIONAL_PHONE;
		length = EncodePhoneNumber(service_center_number,
					   output_buffer + 2, buffer_size - 2);
		if (length < 0 && length >= 254) {
			return -1;
		}
		length++;  // Add type of address.
	}
	output_buffer[0] = length;
	output_buffer_length = length + 1;
	if (output_buffer_length + 4 > buffer_size) {
		return -1;  // Check if it has space for four more bytes.

	}
	// 2. Set type of message.
	output_buffer[output_buffer_length++] = SMS_SUBMIT;
	output_buffer[output_buffer_length++] = 0x00;  // Message reference.

	// 3. Set phone number.
	output_buffer[output_buffer_length] = strlen(phone_number);
	output_buffer[output_buffer_length + 1] = TYPE_OF_ADDRESS_INTERNATIONAL_PHONE;
	length = EncodePhoneNumber(phone_number,
				   output_buffer + output_buffer_length + 2,
				   buffer_size - output_buffer_length - 2);
	output_buffer_length += length + 2;
	if (output_buffer_length + 4 > buffer_size) {
		return -1;  // Check if it has space for four more bytes.


	}
	// 4. Protocol identifiers.
	output_buffer[output_buffer_length++] = 0x00;   // TP-PID: Protocol identifier.
	output_buffer[output_buffer_length++] = 0x00;   // TP-DCS: Data coding scheme.
	output_buffer[output_buffer_length++] = 0xB0;   // TP-VP: Validity: 10 days

	// 5. SMS message.
	const int sms_text_length = strlen(sms_text);
	if (sms_text_length > SMS_MAX_7BIT_TEXT_LENGTH) {
		return -1;
	}
	output_buffer[output_buffer_length++] = sms_text_length;
	length = EncodePDUMessage(sms_text, sms_text_length,
				  output_buffer + output_buffer_length,
				  buffer_size - output_buffer_length);
	if (length < 0) {
		return -1;
	}
	output_buffer_length += length;

	return output_buffer_length;
}

int pdu_decode(const unsigned char *buffer, int buffer_length,
	       time_t *output_sms_time,
	       char *output_sender_phone_number, int sender_phone_number_size,
	       char *output_sms_text, int sms_text_size)
{

	if (buffer_length <= 0) {
		return -1;
	}

	const int sms_deliver_start = 1 + buffer[0];
	if (sms_deliver_start + 1 > buffer_length) {
		return -1;
	}
	if ((buffer[sms_deliver_start] & SMS_DELIVER_ONE_MESSAGE) != SMS_DELIVER_ONE_MESSAGE) {
		return -1;
	}

	const int sender_number_length = buffer[sms_deliver_start + 1];
	if (sender_number_length + 1 > sender_phone_number_size) {
		return -1;  // Buffer too small to hold decoded phone number.

	}
	// const int sender_type_of_address = buffer[sms_deliver_start + 2];
	DecodePhoneNumber(buffer + sms_deliver_start + 3, sender_number_length,  output_sender_phone_number);

	const int sms_pid_start = sms_deliver_start + 3 + (buffer[sms_deliver_start + 1] + 1) / 2;

	// Decode timestamp.
	struct tm sms_broken_time;
	sms_broken_time.tm_year = 100 + SwapDecimalNibble(buffer[sms_pid_start + 2]);
	sms_broken_time.tm_mon = SwapDecimalNibble(buffer[sms_pid_start + 3]) - 1;
	sms_broken_time.tm_mday = SwapDecimalNibble(buffer[sms_pid_start + 4]);
	sms_broken_time.tm_hour = SwapDecimalNibble(buffer[sms_pid_start + 5]);
	sms_broken_time.tm_min = SwapDecimalNibble(buffer[sms_pid_start + 6]);
	sms_broken_time.tm_sec = SwapDecimalNibble(buffer[sms_pid_start + 7]);
	const char gmt_offset = SwapDecimalNibble(buffer[sms_pid_start + 8]);
	// GMT offset is expressed in 15 minutes increments.
	(*output_sms_time) = mktime(&sms_broken_time) - gmt_offset * 15 * 60;

	const int sms_start = sms_pid_start + 2 + 7;
	if (sms_start + 1 > buffer_length) {
		return -1;  // Invalid input buffer.

	}
	const int output_sms_text_length = buffer[sms_start];
	if (sms_text_size < output_sms_text_length) {
		return -1;  // Cannot hold decoded buffer.

	}
	const int decoded_sms_text_size = DecodePDUMessage(buffer + sms_start + 1, buffer_length - (sms_start + 1),
							   output_sms_text, output_sms_text_length);

	if (decoded_sms_text_size != output_sms_text_length) {
		return -1;  // Decoder length is not as expected.

	}
	// Add a C string end.
	if (output_sms_text_length < sms_text_size) {
		output_sms_text[output_sms_text_length] = 0;
	} else {
		output_sms_text[sms_text_size - 1] = 0;
	}

	return output_sms_text_length;
}
```

## src/pdu.h
```c
// Copyright 2011 The Avalon Project Authors. All rights reserved.
// Use of this source code is governed by the Apache License 2.0
// that can be found in the LICENSE file.
#ifndef SMS_PDU_H_
#define SMS_PDU_H_

#include <time.h>

enum { SMS_MAX_PDU_LENGTH = 256 };

/*
 * Encode an SMS message. Output the encoded message into output pdu buffer.
 * Returns the length of the SMS encoded message in the output buffer or
 * a negative number in case encoding failed (for example provided output buffer
 * does not have enough space).
 */
int pdu_encode(const char *service_center_number, const char *phone_number, const char *text,
	       unsigned char *pdu, int pdu_size);

/*
 * Decode an SMS message. Output the decoded message into the sms text buffer.
 * Returns the length of the SMS dencoded message or a negative number in
 * case encoding failed (for example provided output buffer has not enough
 * space).
 */
int pdu_decode(const unsigned char *pdu, int pdu_len,
	       time_t *sms_time,
	       char *phone_number, int phone_number_size,
	       char *text, int text_size);


#endif   // SMS_SMS_H_
```
